## sdkconfig.defaults
```kconfig
# Bluetooth configuration (based on ESP-IDF v5.5 examples)
CONFIG_BT_ENABLED=y
CONFIG_BT_BLE_42_FEATURES_SUPPORTED=y

# WiFi configuration
CONFIG_ESP_WIFI_AUTH_WPA2_PSK=y

# NVS Storage
# Note: NVS encryption is disabled for development
# To enable in production, burn a key to eFuse and configure properly using menuconfig
# CONFIG_NVS_ENCRYPTION is not set

# FreeRTOS
CONFIG_FREERTOS_HZ=1000

# Flash size
CONFIG_ESPTOOLPY_FLASHSIZE_4MB=y

# Partition table
CONFIG_PARTITION_TABLE_CUSTOM=y
CONFIG_PARTITION_TABLE_CUSTOM_FILENAME="partitions.csv"

# Log levels
CONFIG_LOG_DEFAULT_LEVEL_INFO=y
CONFIG_LOG_MAXIMUM_LEVEL_VERBOSE=y

# ESP32-S3 specific
CONFIG_IDF_TARGET="esp32s3"
```
